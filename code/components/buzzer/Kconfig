## code/components/buzzer/Kconfig
```kconfig
menu "Buzzer Configuration"
    config BUZZER_PIN
        int "Buzzer GPIO"
        default 4
        help
            Set the buzzer GPIO.
endmenu
```

## code/components/wifi/Kconfig
```kconfig
menu "Wifi Configuration"

	choice WIFI_MODE
	    bool "Wi-Fi mode"
	    default WIFI_STA
	    help
	    	Select Wi-Fi operation mode.
	
	config WIFI_AP
		bool "AP"
		
	config WIFI_STA
		bool "STA"
		
	config WIFI_APSTA
		bool "AP+STA"
	
	endchoice		
		
    config WIFI_AP_SSID
        string "AP SSID"
        default "esp32s2" 
        depends on WIFI_AP || WIFI_APSTA
        help
            Access point target SSID.
            
    config WIFI_AP_PASS
        string "AP password"
        depends on WIFI_AP || WIFI_APSTA
        help
            Access point target password.
            
    config WIFI_AP_CHANNEL
        int "AP channel"
        default 1
        depends on WIFI_AP || WIFI_APSTA
        help
            Access point target channel.
            
    config WIFI_AP_MAX_STA_CONN
        int "AP maximum connected clients"
        default 8
        depends on WIFI_AP || WIFI_APSTA
        help
            Maximum number of stations connected.

	config WIFI_PROV_ENABLE
		bool "Enable provisioning"
		default y
		depends on WIFI_STA || WIFI_APSTA
		help
			Enable Wi-Fi provisioning service.

    config WIFI_POP_PIN
        string "Proof of possesion"
        depends on WIFI_PROV_ENABLE
        help
            Proof of possesion string. This is relevant only for protocom security 1.

    config WIFI_SSID_PREFIX
        string "SSID prefix"
        default "PROV_"
        depends on WIFI_PROV_ENABLE
        help
        	AP SSID prefix. This is concatenated with the MAC number to build the AP SSID.

endmenu
```

## code/main/Kconfig.projbuild
```kconfig
menu "Application Configuration"

    config APP_RSSI_THRESHOLD_JOIN
        int "RSSI threshold join"
        default -40
        help
            Minimun RSSI threshold to join the network.

    config APP_RSSI_THRESHOLD_DROP_OUT
        int "RSSI threshold drop out"
        default -70
        help
            RSSI threshold to drop out a station from the network.

    config APP_RECONNECTION_TIME
        int "Reconnection time"
        default 20000
        help
            Time to try reconnection in ms.

endmenu
```

## code/sdkconfig.defaults
```kconfig
#
# ESP32S2-specific
#
CONFIG_ESP32_WIFI_STATIC_RX_BUFFER_NUM=8
CONFIG_ESP32_WIFI_DYNAMIC_RX_BUFFER_NUM=32
CONFIG_ESP32_WIFI_DYNAMIC_TX_BUFFER_NUM=32
CONFIG_ESP32_WIFI_AMPDU_TX_ENABLED=y
CONFIG_ESP32_WIFI_TX_BA_WIN=16
CONFIG_ESP32_WIFI_AMPDU_RX_ENABLED=y
CONFIG_ESP32_WIFI_RX_BA_WIN=16

CONFIG_LWIP_TCP_SND_BUF_DEFAULT=32000
CONFIG_LWIP_TCP_WND_DEFAULT=32000
CONFIG_LWIP_TCP_RECVMBOX_SIZE=32
CONFIG_LWIP_UDP_RECVMBOX_SIZE=32
CONFIG_LWIP_TCPIP_RECVMBOX_SIZE=32

CONFIG_ESP32S2_DEFAULT_CPU_FREQ_240=y
CONFIG_ESP32S2_DEFAULT_CPU_FREQ_MHZ=240

CONFIG_ESP32S2_INSTRUCTION_CACHE_16KB=y
CONFIG_ESP32S2_INSTRUCTION_CACHE_LINE_16B=y

CONFIG_LWIP_IRAM_OPTIMIZATION=y

CONFIG_ESP32S2_INSTRUCTION_CACHE_LINE_16B=y
CONFIG_ESP32S2_INSTRUCTION_CACHE_LINE_16B=y

#
# LWIP
#
CONFIG_LWIP_IP_FORWARD=y
CONFIG_LWIP_IPV4_NAPT=y

#
# Wi-Fi Configuration
#
CONFIG_WIFI_APSTA=y
```
